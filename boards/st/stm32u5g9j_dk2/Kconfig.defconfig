## boards/st/stm32u5g9j_dk2/Kconfig.defconfig
```kconfig
# STM32U5G9J DISCOVERY KIT 2 board configuration

# Copyright (c) 2026 FuseTim
# SPDX-License-Identifier: Apache-2.0

if BOARD_STM32U5G9J_DK2

if LVGL

# Enable Neochrom GPU2D graphic acceleration using nemaGFX
configdefault GRAPHICS_ACCELERATOR
	default y

if NEOCHROM_GPU2D

configdefault LV_ATTRIBUTE_MEM_ALIGN_SIZE
	default 8 if NEOCHROM_GPU2D

configdefault LV_Z_NEMA_GFX_MULTI_THREAD
	default y if LV_USE_NEMA_GFX

configdefault LV_USE_NEMA_GFX
	default y

if LV_USE_VECTOR_GRAPHIC
configdefault LV_USE_NEMA_VG
	default y

configdefault LV_NEMA_GFX_MAX_RESX
    default 800

configdefault LV_NEMA_GFX_MAX_RESY
    default 480
endif # LV_USE_VECTOR_GRAPHIC

choice LV_USE_NEMA_HAL
	default LV_NEMA_HAL_CUSTOM
endchoice

choice LV_USE_NEMA_LIB
	default LV_NEMA_LIB_M33_NEMAPVG if LV_USE_NEMA_VG
    default LV_NEMA_LIB_M33_REVC if !LV_USE_NEMA_VG
endchoice

configdefault LV_NEMA_USE_CACHE
	default n 

endif # NEOCHROM_GPU2D

# Enable LVGL Direct Rendering
config LV_USE_DRAW_DMA2D
	default y

config LV_DRAW_DMA2D_HAL_INCLUDE
	default "stm32u5xx.h"

config STM32_LTDC_FB_NUM
	default 0

config LV_Z_VDB_SIZE
	default 100

config LV_Z_DOUBLE_VDB
	default y

choice LV_Z_RENDERING_MODE
	default LV_Z_DIRECT_RENDERING
endchoice

endif # LVGL
endif # BOARD_STM32U5G9J_DK2
```

## drivers/input/Kconfig.tsc2013
```kconfig
# Copyright (c) 2026 FuseTim
# SPDX-License-Identifier: Apache-2.0

menuconfig INPUT_TSC2013
	bool "TSC2013 Resistive 4-wire touch panel driver"
	default y
	depends on DT_HAS_TI_TSC2013_ENABLED
	select I2C
	select INPUT_TOUCH
	help
	  Enable driver for the TSC2013 resistive touch panel controllers.

if INPUT_TSC2013

config INPUT_TSC2013_PERIOD_MS
	int "Sample period"
	depends on !INPUT_TSC2013_INTERRUPT
	default 10
	help
	  Sample period in milliseconds when in polling mode.

config INPUT_TSC2013_INTERRUPT
	bool "Interrupt"
	default n
	help
	  Enable interrupt support (requires GPIO).

endif # INPUT_TSC2013
```

## dts/bindings/input/ti,tsc2013.yaml
```yaml
# Copyright (c) 2026 FuseTim
# SPDX-License-Identifier: Apache-2.0

description: Texas Instruments TSC 2013
compatible: "ti,tsc2013"

include: [i2c-device.yaml, touchscreen-common.yaml]

properties:
  irq-gpios:
    type: phandle-array
  reset-gpios:
    type: phandle-array
```
