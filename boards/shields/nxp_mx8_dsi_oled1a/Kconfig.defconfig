## boards/shields/nxp_mx8_dsi_oled1a/Kconfig.defconfig
```kconfig
#
# Copyright 2026 NXP
#
# SPDX-License-Identifier: Apache-2.0
#

if SHIELD_NXP_MX8_DSI_OLED1A

config GPIO
	default y

config GPIO_ADP5585
	default y

endif # SHIELD_NXP_MX8_DSI_OLED1A
```

## boards/st/stm32u5g9j_dk2/Kconfig.stm32u5g9j_dk2
```kconfig
# Copyright (c) 2025 STMicroelectronics
# SPDX-License-Identifier: Apache-2.0

config BOARD_STM32U5G9J_DK2
	select SOC_STM32U5G9XX

# Enable Neochrom GPU2D graphic acceleration using nemaGFX
if LVGL

config GRAPHICS_ACCELERATOR
	default y

if NEOCHROM_GPU2D

config LV_USE_NEMA_GFX
	default y

config LV_USE_NEMA_LIB
	default 2

endif # NEOCHROM_GPU2D

endif #LVGL
```

## boards/st/stm32u5g9j_dk2/stm32u5g9j_dk2_defconfig
```kconfig
# Copyright (c) 2025 STMicroelectronics
# SPDX-License-Identifier: Apache-2.0

# Enable MPU
CONFIG_ARM_MPU=y

# Enable HW stack protection
CONFIG_HW_STACK_PROTECTION=y

# Enable serial
CONFIG_SERIAL=y

# Enable console
CONFIG_CONSOLE=y
CONFIG_UART_CONSOLE=y

# Enable GPIO
CONFIG_GPIO=y

# TODO: Remove this - but for now, it is needed to ensure proper 
# alignment of LVGL buffers when using the Nema GFX library.
CONFIG_LV_ATTRIBUTE_MEM_ALIGN_SIZE=4
```
